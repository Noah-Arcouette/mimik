## Kconfig
```kconfig
mainmenu "Mimik (Alpha)"

source "config/build.kconfig"
source "config/defaults.kconfig"

source "boot/Kconfig"
source "bin/Kconfig"
source "include/Kconfig"
source "share/Kconfig"
source "usr.bin/Kconfig"
source "usr.lib/Kconfig"
```

## bin/Kconfig
```kconfig
menu "bin/ - essential user binaries"
	config BIN_CAT
		bool "cat"
		help
			Concatenate files together

	config BIN_ECHO
		bool "echo"
		help
			Print strings

	config BIN_UNAME
		bool "uname"
		help
			Print system identification information

	config BIN_TTY
		bool "tty"
		help
			Get user's terminal name

	config BIN_HEAD
		bool "head"
		help
			Copy the first parts of a file

	config BIN_LOGNAME
		bool "logname"
		help
			Print the user's login name

	config BIN_TRUE
		bool "true"
		help
			Return true

	config BIN_FALSE
		bool "false"
		help
			Return false

	config BIN_TEE
		bool "tee"
		help
			Save the contents of standard input

	config BIN_READLINK
		bool "readlink"
		help
			Show where a symbolic link leads to

	config BIN_SLEEP
		bool "sleep"
		help
			Pause execution
endmenu
```

## bin/cat/Kconfig
```kconfig
menuconfig BIN_CAT
	bool "Distribute the cat utility"
	default y

if BIN_CAT

config BIN_CAT_BUFF_SIZE
	int "Amount of read-write at a time"
	default 4096
	help
		Set to 1 to disable all read-write buffering on cat

endif
```

## boot/Kconfig
```kconfig
if !BUILD_HOST

menu "boot/"
	if BUILD_TARGET_X86_64
		source "boot/x86/Kconfig"
	endif
endmenu

endif
```

## boot/x86/bios/Kconfig
```kconfig
menuconfig BOOT_X86_BIOS
	bool "mbr-break.bin, boot-sector.bin"
	default n
if BOOT_X86_BIOS
	choice BOOT_X86_BIOS_OFF
		bool "Boot off of"
		default BOOT_X86_BIOS_OFF_UNKNOWN

		config BOOT_X86_BIOS_OFF_HDD
			bool "Hard Drive"

		config BOOT_X86_BIOS_OFF_FLOPPY
			bool "Floppy Drive"

		config BOOT_X86_BIOS_OFF_UNKNOWN
			bool "Unknown / Other: May not work on few buggy BIOS implementations"
	endchoice

	choice BOOT_X86_BIOS_LANG
		bool "Language"

		config BOOT_X86_BIOS_LANG_EN_US_ASCII
			bool "US English ASCII"
	endchoice

	choice BOOT_X86_BIOS_PART
		bool "Partition Type"

		config BOOT_X86_BIOS_PART_MBR
			bool "MBR, Master Boot Record"
	endchoice

	choice BOOT_X86_BIOS_FS
		bool "File System Type"

		config BOOT_X86_BIOS_FS_TAR
			bool "TAr, Tape Archive"
	endchoice

	config BOOT_X86_BIOS_MAX_MAP
		int "Max BIOS report memory maps"
		default 24
endif

config BOOT_X86_BIOS_ELF
	bool "bios.elf"
	default n
	depends on BOOT_X86_BIOS
```

## boot/x86/mbr/Kconfig
```kconfig
config BOOT_X86_MBR_BIN
	bool "mbr.bin"
	select BUILD_TOOL_AS
	select BUILD_TOOL_AS_X86_16
	select BUILD_TOOL_LD
	# select BUILD_TOOL_MIO2BIN
```

## lib/libc/Kconfig
```kconfig
menuconfig LIB_C
	bool "Distribute C standard library"
	default y

if LIB_C

menu "stdio.h"

config LIB_C_STDIO_BUFSIZ
	int "Default file i/o buffer size"
	default 2048

config LIB_C_STDIO_FOPEN_MAX
	int "Maximum open file streams"
	default 8

endmenu

menu "stdlib.h"

config LIB_C_LIMITS_ATEXIT_MAX
	int "Maximum atexit callbacks functions"
	default 32

endmenu

endif
```

## share/locale/Kconfig
```kconfig
menu "locale/ -- Language specific data"
	source "share/locale/en_CA.utf8/Kconfig"
endmenu
```

## share/locale/en_CA.utf8/Kconfig
```kconfig
menuconfig SHARE_LOCALE_EN_CA_UTF8
	bool "en_CA.utf8/ -- UTF-8 Canadian English"
if SHARE_LOCALE_EN_CA_UTF8
	source "share/locale/en_CA.utf8/man/Kconfig"
endif
```

## share/locale/en_CA.utf8/man/Kconfig
```kconfig
menuconfig SHARE_LOCALE_EN_CA_UTF8_MAN
	bool "man/ -- Manuals"
	default y
if SHARE_LOCALE_EN_CA_UTF8_MAN
	source "share/locale/en_CA.utf8/man/template/Kconfig"
	source "share/locale/en_CA.utf8/man/utility/Kconfig"
	source "share/locale/en_CA.utf8/man/format/Kconfig"
endif
```

## share/locale/en_CA.utf8/man/format/Kconfig
```kconfig
config SHARE_LOCALE_EN_CA_UTF8_MAN_FORMAT
	bool "format/ -- File formats"
	default y
```

## share/locale/en_CA.utf8/man/library/Kconfig
```kconfig
config SHARE_LOCALE_EN_CA_UTF8_MAN_LIBRARY
	bool "library/ -- Library manuals"
	default y
```

## share/locale/en_CA.utf8/man/template/Kconfig
```kconfig
config SHARE_LOCALE_EN_CA_UTF8_MAN_TEMPLATE
	bool "template/ -- Template manuals"
	default y
```

## share/locale/en_CA.utf8/man/utility/Kconfig
```kconfig
config SHARE_LOCALE_EN_CA_UTF8_MAN_UTILITY
	bool "utility/ -- Utility manuals"
	default y
```

## usr.bin/as/Kconfig
```kconfig
config USR_BIN_AS
	bool "as"

config USR_BIN_AS_X86_16
	bool "x86 16bit assembly"
	depends on USR_BIN_AS
```

## usr.bin/readmio/Kconfig
```kconfig
config USR_BIN_READMIO
	bool "readmio"
	help
		Dump the raw information from a MiO file
```

## usr.bin/strip/Kconfig
```kconfig
config USR_BIN_STRIP
	bool "strip"
	help
		Object file optimization, enables LTO in linker
```
