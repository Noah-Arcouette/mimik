## boot/x86/vbr/Kconfig
```kconfig
config BOOT_X86_VBR_BIN
	bool "vbr.bin"
	select BUILD_TOOL_AS
	select BUILD_TOOL_AS_X86_16
	select BUILD_TOOL_LD
	select BUILD_TOOL_MIO2BIN
	help
		The volume boot record loader
		Responsible for loading the core file system, kernel, and init process
```

## include/Kconfig
```kconfig
menuconfig INCLUDE
	bool "include/ -- Source language include files"
if INCLUDE
	config INCLUDE_MIO_H
		bool "mio.h"
		help
			The Mimik Object format

	config INCLUDE_MBR_H
		bool "mbr.h"
		help
			The Master Boot Record partitioning format
endif
```

## share/locale/en_CA.utf8/magic/Kconfig
```kconfig
config SHARE_LOCALE_EN_CA_UTF8_MAGIC
	bool "magic -- Magic file"
	depends on BIN_FILE
	default y
	help
		This is a set of files designed to detect underlying file formats
```

## share/locale/en_CA.utf8/man/abi/Kconfig
```kconfig
config SHARE_LOCALE_EN_CA_UTF8_MAN_ABI
	bool "abi/ -- Application Binary Interfaces"
	default y
```

## usr.bin/Kconfig
```kconfig
menu "usr.bin/ - non-essential user binaries"
	source "usr.bin/as/Kconfig"
	source "usr.bin/ld/Kconfig"
	source "usr.bin/readmio/Kconfig"
	source "usr.bin/strip/Kconfig"
	source "usr.bin/mio2bin/Kconfig"
endmenu
```

## usr.bin/cc/Kconfig
```kconfig
config USR_BIN_CC
	bool "cc"
	help
		The mimik C compiler
config USR_BIN_CC_X86_16
	bool "x86 16bit support"
	depends on USR_BIN_CC
```

## usr.bin/mio2bin/Kconfig
```kconfig
config USR_BIN_MIO2BIN
	bool "mio2bin"
	help
		Link an executable as a flat binary
```

## usr.sbin/Kconfig
```kconfig
menu "usr.sbin/ - non-essential administrative binaries"
	source "usr.sbin/fdisk/Kconfig"
endmenu
```

## usr.sbin/fdisk/Kconfig
```kconfig
menuconfig USR_SBIN_FDISK
	bool "fdisk"
	help
		Partition disks
if USR_SBIN_FDISK
	config USR_SBIN_FDISK_MBR
		bool "MBR support"
		default BUILD_TARGET_X86_64
endif
```
